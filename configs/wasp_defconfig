## configs/wasp_defconfig
```kconfig
CONFIG_ARM=y
CONFIG_POSITION_INDEPENDENT=y
CONFIG_GICV3_SUPPORT_GIC600=y
CONFIG_ARCH_MEDIATEK=y
CONFIG_TEXT_BASE=0x40080000
CONFIG_NR_DRAM_BANKS=2
CONFIG_DEFAULT_DEVICE_TREE="mt6761-nokia-wasp"
CONFIG_SYS_LOAD_ADDR=0x48000000
CONFIG_DEBUG_UART_BASE=0x7d870000
CONFIG_DEBUG_UART_CLOCK=26000000
CONFIG_DEBUG_UART=y
CONFIG_OPTIMIZE_INLINING=y
CONFIG_ENV_VARS_UBOOT_CONFIG=y
CONFIG_SYS_BOOT_GET_CMDLINE=y
CONFIG_SYS_BOOT_GET_KBD=y
# CONFIG_EFI_LOADER is not set
CONFIG_ANDROID_BOOT_IMAGE_IGNORE_BLOB_ADDR=y
CONFIG_FIT=y
CONFIG_FIT_VERBOSE=y
CONFIG_FIT_BEST_MATCH=y
CONFIG_BOOTDELAY=3
CONFIG_USE_BOOTCOMMAND=y
CONFIG_BOOTCOMMAND="fastboot usb 0"
CONFIG_SAVE_PREV_BL_FDT_ADDR=y
CONFIG_SAVE_PREV_BL_INITRAMFS_START_ADDR=y
CONFIG_LOGLEVEL=6
# CONFIG_CONSOLE_MUX is not set
# CONFIG_SYS_DEVICE_NULLDEV is not set
CONFIG_LOG=y
CONFIG_LOGF_FILE=y
CONFIG_LOGF_LINE=y
CONFIG_LOGF_FUNC=y
CONFIG_LOG_ERROR_RETURN=y
CONFIG_STACKPROTECTOR=y
# CONFIG_CMD_BIND is not set
# CONFIG_CMD_CLS is not set
CONFIG_NO_NET=y
CONFIG_CLK=y
CONFIG_CLK_AUTO_ID=y
CONFIG_CLK_STUB=y
CONFIG_USB_FUNCTION_FASTBOOT=y
CONFIG_FASTBOOT_BUF_ADDR=0x48000000
CONFIG_FASTBOOT_OEM_RUN=y
CONFIG_FASTBOOT_OEM_BOARD=y
CONFIG_PHY=y
CONFIG_PHY_MTK_TPHY=y
CONFIG_PHY_COMMON_PROPS=y
CONFIG_BAUDRATE=921600
CONFIG_DM_SERIAL=y
CONFIG_DEBUG_UART_SHIFT=2
CONFIG_DEBUG_UART_ANNOUNCE=y
CONFIG_MTK_SERIAL=y
CONFIG_TIMER=y
CONFIG_MTK_TIMER=y
CONFIG_USB=y
CONFIG_USB_MUSB_GADGET=y
CONFIG_USB_MUSB_MEDIATEK=y
CONFIG_USB_GADGET=y
CONFIG_USB_FUNCTION_ACM=y
CONFIG_VIDEO=y
CONFIG_SYS_WHITE_ON_BLACK=y
CONFIG_VIDEO_SIMPLE=y
CONFIG_BMP_32BPP=y
CONFIG_WDT=y
CONFIG_WDT_MTK=y
```
